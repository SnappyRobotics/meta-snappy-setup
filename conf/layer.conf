## conf/layer.conf
```bitbake
LICENSE = "MIT"
LICENSE_PATH += "${LAYERDIR}/LICENSE"


# We have a conf and classes directory, append to BBPATH
BBPATH .= ":${LAYERDIR}"

# We have a recipes directory, add to BBFILES
BBFILES += "${LAYERDIR}/recipes-*/*/*.bb ${LAYERDIR}/recipes-*/*/*.bbappend"

BBFILE_COLLECTIONS += "snappy-setup-layer"
BBFILE_PATTERN_snappy-setup-layer := "^${LAYERDIR}/"
BBFILE_PRIORITY_snappy-setup-layer = "90"



#LAYERDEPENDS_lxde-layer = "core lxde-layer"





# Let us add layer-specific bbappends which are only applied when that
# layer is included in our configuration
BBFILES += "${@' '.join('${LAYERDIR}/%s/recipes*/*/*.bbappend' % layer \
               for layer in BBFILE_COLLECTIONS.split())}"
# Add layer-specific bb files too
BBFILES += "${@' '.join('${LAYERDIR}/%s/recipes*/*/*.bb' % layer \
               for layer in BBFILE_COLLECTIONS.split())}"
```
